/*
 * Copyright (c) 2024 STMicroelectronics
 *
 * SPDX-License-Identifier: Apache-2.0
 */
#include <zephyr/dt-bindings/sensor/lsm6dsv16x.h>


/*
 * Nucleo F401RE board + shield iks4a1
 *
 * This devicetree overlay file will be automatically picked by the Zephyr
 * build system when building the sample for the nucleo_f401re board.
 */

/ {
	aliases {
		accel0 = &lsm6dsv16x_6b_x_nucleo_iks4a1;
	};
};

&arduino_i2c {
	lsm6dsv16x_6b_x_nucleo_iks4a1: lsm6dsv16x@6b {
		compatible = "st,lsm6dsv16x";
		reg = <0x6b>;
		accel-odr = <LSM6DSV16X_DT_ODR_AT_240Hz>;
		accel-range = <0x03>;
		gyro-odr = <0x07>;
		gyro-range = <0x02>;
		fifo-watermark = <64>;
		accel-fifo-batch-rate = <LSM6DSV16X_DT_XL_BATCHED_AT_30Hz>;
		gyro-fifo-batch-rate = <LSM6DSV16X_DT_GY_BATCHED_AT_30Hz>;
		temp-fifo-batch-rate = <LSM6DSV16X_DT_TEMP_BATCHED_AT_15Hz>;
		int2-gpios =  <&arduino_header 10 GPIO_ACTIVE_HIGH>; /* D4 (PB5) */
		drdy-pin = <2>;
		drdy-pulsed;
	};
};
