## stream_drdy/boards/nucleo_f401re.conf
```kconfig
# Copyright (c) 2024 STMicroelectronics
# SPDX-License-Identifier: Apache-2.0

CONFIG_SPI_RTIO=y
#CONFIG_I2C_RTIO=y
#CONFIG_LSM6DSV16X_STREAM=y
#CONFIG_LSM6DSV16X_ENABLE_TEMP=y
CONFIG_LIS2DUX12_STREAM=y
#CONFIG_LIS2DUX12_ENABLE_TEMP=y
```

## stream_drdy/boards/nucleo_h503rb.conf
```kconfig
# Copyright (c) 2024 STMicroelectronics
# SPDX-License-Identifier: Apache-2.0

CONFIG_I2C_RTIO=y
#CONFIG_SPI_RTIO=y

CONFIG_LSM6DSVXXX_STREAM=y
```
